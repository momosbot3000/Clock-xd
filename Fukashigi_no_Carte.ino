void setup() {
  Serial.begin(9600);
  pinMode(11, OUTPUT);

  uint8_t Notes[][2] = {
    {42, 4}, {49, 4}, {47, 4}, //0
    {49, 12}, {42, 4}, {49, 4}, {47, 4}, //1
    {49, 12}, {42, 4}, {49, 4}, {47, 4}, //2
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    {0, 12} //70
  };


  byte bpm = 140;
  byte buzzer = 11;
  int SizeNotes =  (sizeof(Notes) / sizeof(*Notes));

  Play(Notes, SizeNotes, bpm, buzzer);
  
}


void loop() {
  
  
}

float Frecuency(int note, int octave){
  
  int hz = 440 * pow(1.05946309436, 12 * (octave - 4) + note - 10);
  return hz;

}


float nKey_Hz(uint8_t nKey){

  if(nKey >= 1 && nKey <= 88){
    int sum = 0;
    nKey += 9;
    while(nKey > 12){
      sum++;    
      nKey -= 12;
    }
    int N = nKey;
    int Oc = sum;
  
    float hz = Frecuency(N, Oc);
    return hz;
  }
  else {
    return 0;
  }
}


void Play(uint8_t Notes[][2], int SizeNotes, byte bpm, byte buzzer){
  
  float start = millis();
  float keep = start;
  float beatDuration = 60000 / bpm;

  for (int i = 0; i < SizeNotes; i++) {
    
    float noteDuration = (Notes[i][1] * beatDuration) / 8; 
    float Frecuency = nKey_Hz(Notes[i][0]);

    if(Frecuency > 0){    
      while(millis() <= keep + (noteDuration * 0.9)){
        tone(buzzer, Frecuency);
      }
      while(millis() >= keep + (noteDuration * 0.9) && millis() <= keep + noteDuration){    
        noTone(buzzer);
      }
    }
    else{
      while(millis() <= keep + noteDuration){
        noTone(buzzer);
      }
    }
    keep += noteDuration;
  }
}